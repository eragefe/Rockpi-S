/dts-v1/;
/plugin/;

/ {
    compatible = "radxa,rockpis-rk3308", "rockchip,rk3308";

    fragment@0 {
        target-path = "/";
        __overlay__ {
            ir_recv: ir-receiver {
                status = "okay";
                compatible = "gpio-ir-receiver";
                gpios = <&gpio2 4 0>;  /* GPIO2_A4 0=GPIO_ACTIVE_HIGH */
            };
        };
    };

    fragment@1 {
        target = <&pdm_8ch>;
        __overlay__ {
            status = "disable";
        };
    };

};
